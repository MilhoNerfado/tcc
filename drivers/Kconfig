## drivers/Kconfig
```kconfig
menu "Drivers"
rsource "blink/Kconfig"
rsource "button/Kconfig"
rsource "relay/Kconfig"
rsource "lora_tcp/Kconfig"
endmenu
```

## drivers/button/Kconfig
```kconfig
menuconfig BUTTON
    bool "Blink device drivers"

if BUTTON


module = BUTTON
module-str = button
source "subsys/logging/Kconfig.template.log_config"

endif # BUTTON
```
