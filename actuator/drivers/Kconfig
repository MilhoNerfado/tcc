## actuator_old/Kconfig
```kconfig
menu "Zephyr"
source "Kconfig.zephyr"
endmenu

module = ACTUATOR
module-str = ACTUATOR
source "subsys/logging/Kconfig.template.log_config"
```

## controller_old/Kconfig
```kconfig
menu "Zephyr"
source "Kconfig.zephyr"
endmenu

module = CONTROLLER
module-str = CONTROLLER
source "subsys/logging/Kconfig.template.log_config"
```

## drivers/blink/Kconfig
```kconfig
menuconfig BLINK
    bool "Blink device drivers"

if BLINK

config BLINK_INIT_PRIORITY
    int "Blink priority"
    default KERNEL_INIT_PRIORITY_DEVICE


module = BLINK
module-str = blink
source "subsys/logging/Kconfig.template.log_config"

rsource "Kconfig.gpio_led"

endif # BLINK
```

## drivers/lora_tcp/Kconfig
```kconfig
menuconfig LORA_TCP
    bool "Blink device drivers"

if LORA_TCP

config BLINK_INIT_PRIORITY
    int "Blink priority"
    default KERNEL_INIT_PRIORITY_DEVICE

config LORA_TCP_DEVICE_MAX
    int "Maximum number of registered devices"
    default 1

config LORA_TCP_SHELL
    bool "Enable Lora TCP Shell"
    default true

config LORA_TCP_DATA_MAX_SIZE
    int "Maxumim number of bytes per packet stream"
    default 10

config LORA_TCP_RECV_THREAD_STACK_SIZE
    int "Stack size for the receiving thread"
    default 500

config LORA_TCP_RECV_THREAD_PRIORITY
    int "Priority for the receiving thread"
    default 5

config LORA_TCP_LOG_LEVEL
    int "Lora tcp log level"
    default 2
    range 0 4

config LORA_TCP_NET_LOG_LEVEL
    int "Lora tcp log level for net component"
    default 2
    range 0 4

config LORA_TCP_DEVICE_LOG_LEVEL
    int "Lora tcp log level for device component"
    default 2
    range 0 4

config LORA_TCP_PACKET_LOG_LEVEL
    int "Lora tcp log level for device component"
    default 2
    range 0 4



module = LORA_TCP
module-str = lora_tcp
source "subsys/logging/Kconfig.template.log_config"

endif # LORA_TCP
```

## drivers/modules/Kconfig
```kconfig
menuconfig MODULES
    bool "Blink device drivers"

if MODULES

config MODULES_LOG_LEVEL
    int "Lora tcp log level"
    default 2
    range 0 4


module = MODULES
module-str = modules
source "subsys/logging/Kconfig.template.log_config"

endif # MODULES
```

## drivers/relay/Kconfig
```kconfig
menuconfig RELAY
    bool "Blink device drivers"

if RELAY


module = RELAY
module-str = relay
source "subsys/logging/Kconfig.template.log_config"


endif # RELAY
```

## dts/bindings/mutex/mutex-gpio.yaml
```yaml
# Copyright (c) 2024 Nordic Semiconductor ASA
# SPDX-License-Identifier: Apache-2.0

description: |
  A generic binding for a GPIO-controlled blinking LED. Note that this binding
  has no vendor prefix, as it does not target a specific device or vendor.

  Example definition in devicetree:

    blink-gpio-led {
        compatible = "blink-gpio-led";
        led-gpios = <&gpio0 0 GPIO_ACTIVE_HIGH>;
        blink-period-ms = <1000>;
    };

compatible: "mutex-gpio"

include: base.yaml

properties:
  enable-gpios:
    type: phandle-array
    required: true
    description: GPIO to enable output
  clock-gpios:
    type: phandle-array
    required: true
    description: GPIO to clock
  data-gpios:
    type: phandle-array
    required: true
    description: GPIO to send data
  reset-gpios:
    type: phandle-array
    required: true
    description: GPIO to clear buffer
```
