## CMakeLists.txt
```
#-------------------------------------------------------------------------------
# Zephyr Example Application
#
# Copyright (c) 2021 Nordic Semiconductor ASA
# SPDX-License-Identifier: Apache-2.0

cmake_minimum_required(VERSION 3.13.1)

set(BOARD heltec_wifi_lora32_v2/esp32/procpu)

find_package(Zephyr REQUIRED HINTS $ENV{ZEPHYR_BASE})

project(app LANGUAGES C)

file(GLOB_RECURSE LIB_SRCS "src/libs/*.c")

target_sources(app PRIVATE src/main.c ${LIB_SRCS})
```

## prj.conf
```kconfig
CONFIG_GPIO=y
CONFIG_SPI=y
CONFIG_LORA=y
CONFIG_LOG=y
CONFIG_PRINTK=y

CONFIG_ZBUS=y
CONFIG_ZBUS_MSG_SUBSCRIBER=y

CONFIG_CRC=y

CONFIG_SHELL=y

CONFIG_GPIO=y
CONFIG_BUTTON=y

CONFIG_LOG_DEFAULT_LEVEL=3

# CONFIG_BLINK=y
#
# CONFIG_LORA_TCP=y
# CONFIG_LORA_TCP_SHELL=y
# CONFIG_LORA_TCP_DEVICE_MAX=5


# CONFIG_MODULES=y
```

## src/main.c
```c
#include <zephyr/logging/log.h>
#include <zephyr/kernel.h>

LOG_MODULE_REGISTER(main, LOG_LEVEL_WRN);

#include <zephyr/drivers/lora.h>
#include "libs/lora_udp.h"

int main(void)
{
	LOG_WRN(" --- ACTUATOR INIT --- ");

	init_radio();

	while (true) {
		k_msleep(1000);
	}
}
```
